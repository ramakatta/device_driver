## yocto/meta-yocto-experiments-styhead-20250216T181703Z-001/meta-yocto-experiments-styhead/conf/layer.conf
```bitbake
# We have a conf and classes directory, add to BBPATH
BBPATH .= ":${LAYERDIR}"

# We have recipes-* directories, add to BBFILES
BBFILES += "${LAYERDIR}/recipes-*/*/*.bb \
            ${LAYERDIR}/recipes-*/*/*.bbappend"

BBFILE_COLLECTIONS += "meta-yocto-experiments"
BBFILE_PATTERN_meta-yocto-experiments = "^${LAYERDIR}/"
BBFILE_PRIORITY_meta-yocto-experiments = "6"

LAYERDEPENDS_meta-yocto-experiments = "core"
LAYERSERIES_COMPAT_meta-yocto-experiments = "styhead walnascar"
```
